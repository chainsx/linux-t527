## bsp/drivers/dma-buf/heaps/Kconfig
```kconfig
config AW_DMABUF_HEAPS_SYSTEM_UNCACHED
	bool "AW DMA-BUF System-Uncached Heap"
	depends on DMABUF_HEAPS
	default n
	help
	  Choose this option to enable the system-uncached dmabuf heap. The system-uncached heap
	  is backed by pages from the buddy allocator. If in doubt, say Y.
```

## bsp/drivers/net/phy/Kconfig
```kconfig
# SPDX-License-Identifier: GPL-2.0-only
#
# PHY Layer Configuration
#

menu "PHY"
        depends on PHYLIB

source "bsp/drivers/net/phy/jlsemi/Kconfig"

endmenu
```

## bsp/drivers/net/phy/jlsemi/Kconfig
```kconfig
# SPDX-License-Identifier: GPL-2.0-only


config JLSEMI_PHY
	tristate "JLSEMI PHYs"
	help
		Currently has a driver for the jlsemi
```

## bsp/drivers/pci/Kconfig
```kconfig
# SPDX-License-Identifier: GPL-2.0
#
# PCI configuration
#

menu "PCI Drivers"

if PCI
source "bsp/drivers/pci/controller/Kconfig"
endif

endmenu
```

## bsp/drivers/pci/controller/Kconfig
```kconfig
# SPDX-License-Identifier: GPL-2.0

menu "PCI controller drivers"
	depends on PCI

source "bsp/drivers/pci/controller/allwinner/Kconfig"
source "bsp/drivers/pci/controller/dwc/Kconfig"

endmenu
```

## bsp/drivers/pci/controller/allwinner/Kconfig
```kconfig
# SPDX-License-Identifier: GPL-2.0-only

menu "Allwinner PCIe controller"
	depends on OF && AW_BSP
	depends on PCI

choice
	prompt "Allwinner PCIe controller"
	default  AW_PCIE_NONE

config AW_PCIE_RC
	tristate "Allwinner PCIe RC controller - Host mode"
	depends on AW_BSP
	help
	  Enables support for the PCIe RC controller in the Allwinner SoC.

config AW_PCIE_EP
	tristate "EP controller - Endpoint mode"
	select PCI_ENDPOINT
	depends on AW_BSP
	help
	  Enables support for the PCIe EP controller in the Allwinner SoC.

config AW_PCIE_NONE
	tristate "None"
	depends on AW_BSP
	help
	  Disable support for the PCIe controller in the Allwinner SoC.

endchoice

endmenu
```

## bsp/drivers/pci/controller/dwc/Kconfig
```kconfig
# SPDX-License-Identifier: GPL-2.0-only

menu "DesignWare-based PCIe controller"
	depends on PCI

config PCIE_DW_SUNXI_HOST
	tristate "Allwinner DesignWare PCIe controller - Host mode"
	select PCIE_DW
	select PCIE_DW_HOST
	depends on PCI_MSI
	depends on OF && AW_BSP
	help
	  Enables support for the DesignWare PCIe controller in the
	  Allwinner SoCs.

endmenu
```

## bsp/drivers/sound/Kconfig
```kconfig
# SPDX-License-Identifier: GPL-2.0-or-later
#
# Allwinner audio driver Kconfig
#
# Copyright(c) 2022-2027 Allwinnertech Co., Ltd.

menu "SOUND Drivers"
	depends on AW_BSP

if SND_SOC
	if ARCH_SUN60IW3
		source "bsp/drivers/sound/ahub/Kconfig"
	endif
	if !ARCH_SUN60IW3
		source "bsp/drivers/sound/platform/Kconfig"
	endif
	source "bsp/drivers/sound/codecs/Kconfig"
	source "bsp/drivers/sound/misc/Kconfig"
	source "bsp/drivers/sound/pa/Kconfig"
endif

endmenu
```

## bsp/drivers/sound/ahub/Kconfig
```kconfig
# SPDX-License-Identifier: GPL-2.0-or-later
#
# Allwinner audio ahub driver Kconfig
#
# Copyright(c) 2022-2027 Allwinnertech Co., Ltd.

# aaudio
config SND_SOC_SUNXI_AHUB_AAUDIO
	tristate

# common
config SND_SOC_SUNXI_AHUB_COMMON
	tristate

# ahub
config SND_SOC_SUNXI_AHUB_MGMT
	tristate

# machine
config SND_SOC_SUNXI_AHUB_MACH
	tristate

# menu select
menu "AHUB drivers"

# module
config SND_SOC_SUNXI_AHUB_AC203C
	tristate "Allwinner AHUB AC203C support"
	select REGMAP_MMIO
	select SND_SOC_GENERIC_DMAENGINE_PCM
	select SND_SOC_SUNXI_AHUB_COMMON
	select SND_SOC_SUNXI_AHUB_AAUDIO
	select SND_SOC_SUNXI_AHUB_MGMT
	select SND_SOC_SUNXI_AHUB_MACH
	help
	  Select Y or M to support AHUB AC203C Module in Allwinner SoCs.

config SND_SOC_SUNXI_AHUB_I2S
	tristate "Allwinner AHUB I2S support"
	select REGMAP_MMIO
	select SND_SOC_GENERIC_DMAENGINE_PCM
	select SND_SOC_SUNXI_AHUB_COMMON
	select SND_SOC_SUNXI_AHUB_MGMT
	select SND_SOC_SUNXI_AHUB_MACH
	help
	  Select Y or M to support AHUB I2S Module in Allwinner SoCs.

config SND_SOC_SUNXI_AHUB_OWA
	tristate "Allwinner AHUB OWA support"
	select REGMAP_MMIO
	select SND_SOC_GENERIC_DMAENGINE_PCM
	select SND_SOC_SUNXI_AHUB_COMMON
	select SND_SOC_SUNXI_AHUB_MGMT
	select SND_SOC_SUNXI_AHUB_MACH
	help
	  Select Y or M to support AHUB OWA Module in Allwinner SoCs.

config SND_SOC_SUNXI_AHUB_DMIC
	tristate "Allwinner AHUB DMIC support"
	select REGMAP_MMIO
	select SND_SOC_GENERIC_DMAENGINE_PCM
	select SND_SOC_SUNXI_AHUB_COMMON
	select SND_SOC_SUNXI_AHUB_MGMT
	select SND_SOC_SUNXI_AHUB_MACH
	help
	  Select Y or M to support AHUB DMIC Module in Allwinner SoCs.

config SND_SOC_SUNXI_DEBUG
	tristate "Enable snd_sunxi debug"
	default y
	help
	  Select Y or M to support snd_sunxi debug.

config SND_SOC_SUNXI_DYNAMIC_DEBUG
	bool "Enable audio dynamic debug"
	default y
	help
	  Enable audio dynamic debug

endmenu
```

## bsp/drivers/sound/codecs/Kconfig
```kconfig
# SPDX-License-Identifier: GPL-2.0-or-later
#
# Allwinner audio codecs driver Kconfig
#
# Copyright(c) 2022-2027 Allwinnertech Co., Ltd.

menu "CODEC drivers"

# HDMIAUDIO
config SND_SOC_SUNXI_CODEC_HDMI
	tristate "Allwinner HDMIAUDIO support"
	depends on ARCH_SUN55IW3 \
		|| ARCH_SUN8IW11 \
		|| ARCH_SUN8IW20  \
		|| ARCH_SUN20IW1  \
		|| ARCH_SUN50IW9  \
		|| ARCH_SUN55IW7  \
		|| ARCH_SUN65IW1 \
		|| ARCH_SUN60IW2
	help
	  Select Y or M to support hdmi audio in Allwinner SoCs.

# HDMI2 AUDIO
config SND_SOC_SUNXI_CODEC_HDMI_2
	tristate "Allwinner NEW HDMIAUDIO support"
	depends on ARCH_SUN60IW2
	help
	  Select Y or M to support hdmi audio in Allwinner SoCs.

# EDPAUDIO
config SND_SOC_SUNXI_CODEC_EDP
	tristate "Allwinner EDPAUDIO support"
	depends on ARCH_SUN55IW3 \
		|| ARCH_SUN65IW1
	help
	  Select Y or M to support edp audio in Allwinner SoCs.

# AVAUDIO
config SND_SOC_SUNXI_CODEC_AV
	tristate "Allwinner AVAUDIO support"
	depends on ARCH_SUN60IW2 \
		|| ARCH_SUN65IW1
	help
	  Select Y or M to support av audio in Allwinner SoCs.

config SND_SOC_AC101
	tristate "Allwinner AC101 CODEC"
	depends on I2C
	default n
	help
	  Enable support for the Allwinner AC101 CODEC.
	  The device provides a I2S/TDM/PDM interface for audio data
	  and a standard I2C interface for control data communication.
	  Select this if your sound card has AC101.

config SND_SOC_AC101B
	tristate "Allwinner AC101B CODEC"
	depends on I2C
	default n
	help
	  Enable support for the Allwinner AC101B CODEC.
	  The device provides a I2S/TDM/PDM interface for audio data
	  and a standard I2C interface for control data communication.
	  Select this if your sound card has AC101B.

config SND_SOC_AC107
	tristate "Allwinner AC107 CODEC"
	depends on I2C
	default n
	help
	  Enable support for the Allwinner AC107 CODEC.
	  The device provides a I2S/TDM/PDM interface for audio data
	  and a standard I2C interface for control data communication.
	  Select this if your sound card has AC107.

config SND_SOC_AC108
	tristate "Allwinner AC108 CODEC"
	depends on I2C
	default n
	help
	  Enable support for the Allwinner AC108 CODEC.
	  The device provides a I2S/TDM/PDM interface for audio data
	  and a standard I2C interface for control data communication.
	  Select this if your sound card has AC108.

config SND_SOC_FS16XX
	tristate "SoC Audio for FourSemi FS1894SU PA"
	depends on I2C
	default n
	help
	  This option enables support for FourSemi PA.
	  The device supports a I2S interface for audio data
	  and a standard I2C interface for control data communication.
	  Select this if your sound card has FourSemi FS1894SU PA.

config SND_SOC_ES8323
	tristate "ES8323"
	depends on I2C
	default n
	help
	  Enable support for the es8323.
	  The device provides a I2S/TDM/PDM interface for audio data
	  and a standard I2C interface for control data communication.
	  Select this if your sound card has es8323.

endmenu
```

## bsp/drivers/twi/Kconfig
```kconfig
# SPDX-License-Identifier: GPL-2.0-only
#
# TWI drivers configuration
#
menu "TWI Drivers"
	depends on AW_BSP

config AW_TWI
	tristate "I2C Support for Allwinner SoCs"
	depends on AW_DMA
	select HAS_IOMEM
	select I2C
	select I2C_CHARDEV
	help
	  If you say yes to this option, support will be included for the
	  TWI interface from Allwinner SoCs.

config AW_TWI_DELAYINIT
	bool "SUNXI TWI hardware init delay"
	depends on AW_TWI
	help
	  If you need to use twi in the heterogeneous core first and then
	  notify twi in linux to obtain hardware resources, you can say yes
	  to this option, twi hardware resource init will be delayed.

config AW_TWI_DVFS
	bool "SUNXI TWI dvfs function "
	depends on AW_TWI
	default n
	help
	  If you want to use the dvfs function, you need to set this option to y,
	  provided that the twi of the current platform supports the dvfs function

config AW_TWI_DYNAMIC_DEBUG
	bool "SUNXI TWI DYNAMIC DEBUG"
	depends on AW_TWI
	help
	  If you need to print twi information, you can say yes to this option.

endmenu
```
